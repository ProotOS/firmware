## sdkconfig.defaults
```kconfig
# ─── Prootos Firmware — shared sdkconfig defaults ────────────────────
# Applied to all targets. Target-specific overrides in sdkconfig.defaults.<target>

# ─── Partition table ─────────────────────────────────────────────────
CONFIG_PARTITION_TABLE_CUSTOM=y
CONFIG_PARTITION_TABLE_CUSTOM_FILENAME="partitions.csv"

# ─── BLE ─────────────────────────────────────────────────────────────
CONFIG_BT_ENABLED=y
CONFIG_BT_BLUEDROID_ENABLED=y
CONFIG_BT_BLE_ENABLED=y
CONFIG_BT_GATTC_ENABLE=y
CONFIG_BT_BLE_SMP_ENABLE=y
CONFIG_BT_ACL_CONNECTIONS=4
CONFIG_BT_MULTI_CONNECTION_ENBALE=y
CONFIG_BT_SMP_MAX_BONDS=15
CONFIG_BT_GATTC_MAX_CACHE_CHAR=40
CONFIG_BT_GATTC_NOTIF_REG_MAX=5

# ─── WiFi ────────────────────────────────────────────────────────────
CONFIG_ESP_WIFI_ENABLED=y
CONFIG_ESP_WIFI_NVS_ENABLED=y
CONFIG_ESP_WIFI_ENABLE_WPA3_SAE=y
CONFIG_ESP_WIFI_SW_COEXIST_ENABLE=y

# ─── LVGL ────────────────────────────────────────────────────────────
CONFIG_LV_FONT_MONTSERRAT_14=y
CONFIG_LV_FONT_DEFAULT_MONTSERRAT_14=y
CONFIG_LV_COLOR_16_SWAP=y
```

## sdkconfig.defaults.esp32c6
```kconfig
# ─── ESP32-C6 specific overrides ─────────────────────────────────────
# Waveshare ESP32-C6-LCD-1.69: 16MB flash, no PSRAM

# ─── Flash ───────────────────────────────────────────────────────────
CONFIG_ESPTOOLPY_FLASHSIZE_16MB=y
CONFIG_ESPTOOLPY_FLASHSIZE="16MB"

# ─── No PSRAM ────────────────────────────────────────────────────────
# CONFIG_SPIRAM is not set

# ─── BLE 5.3 ────────────────────────────────────────────────────────
CONFIG_BT_BLE_50_FEATURES_SUPPORTED=y
```

## sdkconfig.defaults.esp32s3
```kconfig
# ─── ESP32-S3 specific overrides ─────────────────────────────────────
# Waveshare ESP32-S3-Touch-LCD-1.46B: 16MB flash, 8MB octal PSRAM

# ─── Flash ───────────────────────────────────────────────────────────
CONFIG_ESPTOOLPY_FLASHSIZE_16MB=y
CONFIG_ESPTOOLPY_FLASHSIZE="16MB"

# ─── PSRAM (8MB octal) ──────────────────────────────────────────────
CONFIG_SPIRAM=y
CONFIG_SPIRAM_MODE_OCT=y
CONFIG_SPIRAM_TYPE_AUTO=y
CONFIG_SPIRAM_ALLOW_STACK_EXTERNAL_MEMORY=y
CONFIG_SPIRAM_SPEED_80M=y
CONFIG_SPIRAM_BOOT_INIT=y
CONFIG_SPIRAM_USE_MALLOC=y
CONFIG_SPIRAM_MEMTEST=y
CONFIG_SPIRAM_MALLOC_ALWAYSINTERNAL=16384
CONFIG_SPIRAM_MALLOC_RESERVE_INTERNAL=32768

# ─── BLE 5.0 ────────────────────────────────────────────────────────
CONFIG_BT_BLE_50_FEATURES_SUPPORTED=y
CONFIG_BT_ALLOCATION_FROM_SPIRAM_FIRST=y
```
